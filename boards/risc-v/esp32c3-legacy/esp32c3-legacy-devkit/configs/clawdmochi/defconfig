## boards/risc-v/esp32c3-legacy/esp32c3-legacy-devkit/configs/clawdmochi/defconfig
```kconfig
#
# ClawdMochi ESP32-C3 single system
#
# CONFIG_NSH_ARGCAT is not set
# CONFIG_NSH_CMDOPT_HEXDUMP is not set
# CONFIG_EXAMPLES_HELLO is not set
# CONFIG_EXAMPLES_HELLOXX is not set
# CONFIG_TESTING_GETPRIME is not set
# CONFIG_TESTING_OSTEST is not set
CONFIG_ARCH="risc-v"
CONFIG_ARCH_BOARD="esp32c3-legacy-devkit"
CONFIG_ARCH_BOARD_COMMON=y
CONFIG_ARCH_BOARD_ESP32C3_LEGACY_DEVKIT=y
CONFIG_ARCH_CHIP="esp32c3-legacy"
CONFIG_ARCH_CHIP_ESP32C3WROOM02=y
CONFIG_ARCH_CHIP_ESP32C3_LEGACY=y
CONFIG_ARCH_INTERRUPTSTACK=4096
CONFIG_ARCH_RISCV=y
CONFIG_ARCH_STACKDUMP=y
CONFIG_BOARDCTL_RESET=y
CONFIG_BOARD_LATE_INITIALIZE=y
CONFIG_BOARD_LOOPSPERMSEC=15000
CONFIG_BUILTIN=y
CONFIG_DRIVERS_IEEE80211=y
CONFIG_DRIVERS_WIRELESS=y
CONFIG_ELF=y
CONFIG_ESP32C3_APP_FORMAT_LEGACY=y
CONFIG_ESP32C3_BOOTLOADER_BUILD_FROM_SOURCE=y
CONFIG_ESP32C3_FLASH_4M=y
CONFIG_ESP32C3_PARTITION_TABLE_OFFSET=0x8000
CONFIG_ESP32C3_SPIFLASH=y
CONFIG_ESP32C3_SPIFLASH_LITTLEFS=y
CONFIG_ESP32C3_STORAGE_MTD_OFFSET=0x150000
CONFIG_ESP32C3_STORAGE_MTD_SIZE=0x2b0000
# CONFIG_ESP32C3_UART0 is not set
CONFIG_ESP32C3_USBSERIAL=y
CONFIG_ESP32C3_WIFI=y
CONFIG_ETC_ROMFS=y
CONFIG_ETC_ROMFSDEVNO=6
CONFIG_EXAMPLES_CLAWDMOCHI_POSIX=y
CONFIG_EXAMPLES_CLAWDMOCHI_POSIX_ITERATIONS=25
CONFIG_EXAMPLES_CLAWDMOCHI_POSIX_STACKSIZE=8192
CONFIG_EXECFUNCS_HAVE_SYMTAB=y
CONFIG_EXECFUNCS_SYSTEM_SYMTAB=y
CONFIG_FS_PROCFS=y
CONFIG_IDLETHREAD_STACKSIZE=3072
CONFIG_INIT_ENTRYPOINT="nsh_main"
CONFIG_INIT_STACKSIZE=8192
CONFIG_INTELHEX_BINARY=y
CONFIG_IOB_NBUFFERS=124
CONFIG_IOB_THROTTLE=24
CONFIG_LIBC_MAX_EXITFUNS=1
CONFIG_LIBC_EXECFUNCS=y
CONFIG_LIBC_PERROR_STDOUT=y
CONFIG_LIBC_STRERROR=y
CONFIG_LIBM=y
CONFIG_LIBM_TOOLCHAIN=n
CONFIG_LINE_MAX=64
CONFIG_NAME_MAX=48
CONFIG_NETDB_DNSCLIENT=y
CONFIG_NETDEV_LATEINIT=y
CONFIG_NETDEV_PHY_IOCTL=y
CONFIG_NETDEV_WIRELESS_IOCTL=y
CONFIG_NETINIT_DHCPC=y
# CONFIG_NETINIT_THREAD is not set
CONFIG_NETINIT_THREAD_STACKSIZE=4096
CONFIG_NETINIT_WAPI_ALG_CCMP=y
CONFIG_NETINIT_WAPI_AUTHWPA_WPA2=y
CONFIG_NETINIT_WAPI_CIPHERMODE_CCMP=y
CONFIG_NETINIT_WAPI_PASSPHRASE="invo@123456"
CONFIG_NETINIT_WAPI_SSID="invo-lan"
CONFIG_NETINIT_WAPI_STAMODE_INFRA=y
CONFIG_NETUTILS_CJSON=y
CONFIG_NETUTILS_DHCPC=y
CONFIG_NET_BROADCAST=y
CONFIG_NET_ETH_PKTSIZE=1514
CONFIG_NET_ICMP_SOCKET=y
CONFIG_NET_TCP=y
CONFIG_NET_TCP_DELAYED_ACK=y
CONFIG_NET_TCP_WRITE_BUFFERS=y
CONFIG_NET_UDP=y
CONFIG_NET_UDP_WRITE_BUFFERS=y
CONFIG_NFILE_DESCRIPTORS_PER_BLOCK=6
CONFIG_NSH_BUILTIN_APPS=y
CONFIG_NSH_FILEIOSIZE=512
CONFIG_NSH_FILE_APPS=y
# CONFIG_NSH_NETINIT is not set
CONFIG_NSH_READLINE=y
CONFIG_NSH_STRERROR=y
CONFIG_POSIX_SPAWN_DEFAULT_STACKSIZE=8192
CONFIG_PREALLOC_TIMERS=4
CONFIG_PTHREAD_MUTEX_TYPES=y
CONFIG_PTHREAD_STACK_DEFAULT=8192
CONFIG_RR_INTERVAL=200
CONFIG_SCHED_LPWORK=y
CONFIG_SCHED_WAITPID=y
CONFIG_SIG_DEFAULT=y
CONFIG_START_DAY=16
CONFIG_START_MONTH=11
CONFIG_START_YEAR=2026
CONFIG_SYMTAB_ORDEREDBYNAME=y
CONFIG_SYSTEM_DHCPC_RENEW=y
CONFIG_SYSTEM_NSH=y
CONFIG_SYSTEM_PING=y
CONFIG_TASK_NAME_SIZE=12
CONFIG_TLS_TASK_NELEM=4
CONFIG_WIRELESS=y
CONFIG_WIRELESS_WAPI=y
CONFIG_WIRELESS_WAPI_CMDTOOL=y
CONFIG_WIRELESS_WAPI_INITCONF=y
CONFIG_WIRELESS_WAPI_STACKSIZE=4096
```
